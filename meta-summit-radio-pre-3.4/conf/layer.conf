## meta-summit-radio-pre-3.4/conf/layer.conf
```bitbake
# We have a conf and classes directory, add to BBPATH
BBPATH .= ":${LAYERDIR}"

# We have recipes-* directories, add to BBFILES
BBFILES += "${LAYERDIR}/recipes-*/*/*.bb \
	${LAYERDIR}/recipes-*/*/*.bbappend"

BBFILE_COLLECTIONS += "summit-radio-pre-3.4"
BBFILE_PATTERN_summit-radio-pre-3.4 = "^${LAYERDIR}/"
BBFILE_PRIORITY_summit-radio-pre-3.4 = "8"

BB_DANGLINGAPPENDS_WARNONLY = "1"

RFPROS_FILESHARE_AUTH ?= ""

LAYERSERIES_COMPAT_summit-radio-pre-3.4 = "sumo thud warrior zeus dunfell gatesgarth hardknott"

PREMIRRORS_prepend = "\
	https://github.com/Ezurio/Sterling-60-Release-Packages/releases/download/.*/.*     file://${TOPDIR}/../release \n\
	https://github.com/Ezurio/SonaIF-Release-Packages/releases/download/.*/.*     file://${TOPDIR}/../release \n\
	https://github.com/Ezurio/SonaNX-Release-Packages/releases/download/.*/.*     file://${TOPDIR}/../release \n\
	https://github.com/Ezurio/SonaTI-Release-Packages/releases/download/.*/.*     file://${TOPDIR}/../release \n\
	https://github.com/Ezurio/BDSDMAC-Release-Packages/releases/download/.*/.*     file://${TOPDIR}/../release \n\
	"
```
